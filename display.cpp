// Status display for LilyGO T-Dongle-S3 style boards (ST7735 0.96" 160x80 IPS)
// Minimal dependency-free driver: no external library needed.
// Shows IP, status, blocked/allowed counters, blocklist size, RSSI, uptime, free memory.

#include "appGlobals.h"
#include <SPI.h>
#include <WiFi.h>

// pins of the GNPE 'Pocket-Dongle-S3' clone (from lucanenni/spark-go-utils, ESP32-S3-ChocolatePlus-bridge)
#define TFT_MOSI 11
#define TFT_SCLK 10
#define TFT_CS   12
#define TFT_DC   13
#define TFT_RST  14
#define TFT_BL   -1          // backlight is hardwired on, no GPIO
#define BL_ACTIVE_LOW false

#define TFT_W 160
#define TFT_H 80
// panel offsets for 0.96" 80x160 ST7735S in landscape
#define X_OFF 0
#define Y_OFF 24
// MADCTL: 0xA0 = landscape; try 0x60 if the picture is upside down
#define TFT_MADCTL 0xA8 // MY|MV|BGR (panel is BGR); 0x68 if upside down

#define C_BLACK  0x0000
#define C_WHITE  0xFFFF
#define C_GREEN  0x07E0
#define C_RED    0xF800
#define C_YELLOW 0xFFE0
#define C_CYAN   0x07FF
#define C_GREY   0x8410

static SPIClass tftSPI(HSPI);
static const SPISettings tftSet(27000000, MSBFIRST, SPI_MODE0);

// 5x7 font, ASCII 32..127 (subset used: 32..126)
static const uint8_t font5x7[] PROGMEM = {
0x00,0x00,0x00,0x00,0x00, 0x00,0x00,0x5F,0x00,0x00, 0x00,0x07,0x00,0x07,0x00, 0x14,0x7F,0x14,0x7F,0x14,
0x24,0x2A,0x7F,0x2A,0x12, 0x23,0x13,0x08,0x64,0x62, 0x36,0x49,0x55,0x22,0x50, 0x00,0x05,0x03,0x00,0x00,
0x00,0x1C,0x22,0x41,0x00, 0x00,0x41,0x22,0x1C,0x00, 0x14,0x08,0x3E,0x08,0x14, 0x08,0x08,0x3E,0x08,0x08,
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0x00,0x00,0x7F,0x00,0x00, 0x00,0x41,0x36,0x08,0x00, 0x08,0x04,0x08,0x10,0x08
};

static void wrCmd(uint8_t c) {
  digitalWrite(TFT_DC, LOW);
  digitalWrite(TFT_CS, LOW);
  tftSPI.transfer(c);
  digitalWrite(TFT_CS, HIGH);
}

static void wrData(const uint8_t* d, size_t n) {
  digitalWrite(TFT_DC, HIGH);
  digitalWrite(TFT_CS, LOW);
  tftSPI.writeBytes(d, n);
  digitalWrite(TFT_CS, HIGH);
}

static void cmd(uint8_t c, std::initializer_list<uint8_t> args = {}) {
  wrCmd(c);
  if (args.size()) { uint8_t b[20]; size_t i = 0; for (uint8_t a : args) b[i++] = a; wrData(b, i); }
}

static void setWindow(int x0, int y0, int x1, int y1) {
  x0 += X_OFF; x1 += X_OFF; y0 += Y_OFF; y1 += Y_OFF;
  cmd(0x2A, {(uint8_t)(x0 >> 8), (uint8_t)x0, (uint8_t)(x1 >> 8), (uint8_t)x1});
  cmd(0x2B, {(uint8_t)(y0 >> 8), (uint8_t)y0, (uint8_t)(y1 >> 8), (uint8_t)y1});
  wrCmd(0x2C);
}

static void fillRect(int x, int y, int w, int h, uint16_t color) {
  if (x >= TFT_W || y >= TFT_H || w <= 0 || h <= 0) return;
  if (x + w > TFT_W) w = TFT_W - x;
  if (y + h > TFT_H) h = TFT_H - y;
  setWindow(x, y, x + w - 1, y + h - 1);
  static uint8_t line[TFT_W * 2];
  for (int i = 0; i < w; i++) { line[2 * i] = color >> 8; line[2 * i + 1] = color; }
  digitalWrite(TFT_DC, HIGH);
  digitalWrite(TFT_CS, LOW);
  for (int r = 0; r < h; r++) tftSPI.writeBytes(line, w * 2);
  digitalWrite(TFT_CS, HIGH);
}

// draw text with scale 1 (6x8 cell) or 2; pads the rest of the line with background up to padTo pixels
static void drawText(int x, int y, const char* s, uint16_t fg, uint16_t bg, int scale = 1, int padTo = 0) {
  static uint8_t buf[TFT_W * 16 * 2];
  int cw = 6 * scale, ch = 8 * scale;
  int n = strlen(s);
  int w = n * cw;
  if (padTo > w) w = padTo;
  if (x + w > TFT_W) w = TFT_W - x;
  if (w <= 0) return;
  setWindow(x, y, x + w - 1, y + ch - 1);
  for (int row = 0; row < ch; row++) {
    for (int col = 0; col < w; col++) {
      int ci = col / cw, cx = (col % cw) / scale, cy = row / scale;
      bool on = false;
      if (ci < n && cx < 5 && cy < 7) {
        char c = s[ci];
        if (c < 32 || c > 126) c = '?';
        on = (pgm_read_byte(&font5x7[(c - 32) * 5 + cx]) >> cy) & 1;
      }
      uint16_t p = on ? fg : bg;
      buf[2 * col] = p >> 8; buf[2 * col + 1] = p;
    }
    digitalWrite(TFT_DC, HIGH);
    digitalWrite(TFT_CS, LOW);
    tftSPI.writeBytes(buf, w * 2);
    digitalWrite(TFT_CS, HIGH);
  }
}

static void tftInit() {
  pinMode(TFT_CS, OUTPUT); digitalWrite(TFT_CS, HIGH);
  pinMode(TFT_DC, OUTPUT);
  pinMode(TFT_RST, OUTPUT);
  tftSPI.begin(TFT_SCLK, -1, TFT_MOSI, TFT_CS);
  tftSPI.beginTransaction(tftSet);

  digitalWrite(TFT_RST, HIGH); delay(10);
  digitalWrite(TFT_RST, LOW);  delay(20);
  digitalWrite(TFT_RST, HIGH); delay(120);

  cmd(0x01); delay(150);          // software reset
  cmd(0x11); delay(120);          // sleep out
  cmd(0xB1, {0x01, 0x2C, 0x2D});
  cmd(0xB2, {0x01, 0x2C, 0x2D});
  cmd(0xB3, {0x01, 0x2C, 0x2D, 0x01, 0x2C, 0x2D});
  cmd(0xB4, {0x07});
  cmd(0xC0, {0xA2, 0x02, 0x84});
  cmd(0xC1, {0xC5});
  cmd(0xC2, {0x0A, 0x00});
  cmd(0xC3, {0x8A, 0x2A});
  cmd(0xC4, {0x8A, 0xEE});
  cmd(0xC5, {0x0E});
  cmd(0xE0, {0x02, 0x1C, 0x07, 0x12, 0x37, 0x32, 0x29, 0x2D, 0x29, 0x25, 0x2B, 0x39, 0x00, 0x01, 0x03, 0x10});
  cmd(0xE1, {0x03, 0x1D, 0x07, 0x06, 0x2E, 0x2C, 0x29, 0x2D, 0x2E, 0x2E, 0x37, 0x3F, 0x00, 0x00, 0x02, 0x10});
  cmd(0x3A, {0x05});              // 16 bit colour
  cmd(0x21);                      // inversion on (needed by this IPS panel)
  cmd(0x36, {TFT_MADCTL});
  cmd(0x13);                      // normal mode
  cmd(0x29); delay(50);           // display on
  fillRect(0, 0, TFT_W, TFT_H, C_BLACK);
}

static void fmtUptime(char* out, size_t n, uint32_t sec) {
  uint32_t d = sec / 86400, h = (sec % 86400) / 3600, m = (sec % 3600) / 60;
  if (d) snprintf(out, n, "%lud%02luh", (unsigned long)d, (unsigned long)h);
  else snprintf(out, n, "%luh%02lum", (unsigned long)h, (unsigned long)m);
}

static void displayTask(void*) {
  tftInit();
  char line[40], prev[8][40] = {{0}};
  uint16_t prevCol[8] = {0};
  auto show = [&](int idx, int y, const char* s, uint16_t col, int scale = 1) {
    if (strcmp(prev[idx], s) || prevCol[idx] != col) {
      drawText(2, y, s, col, C_BLACK, scale, TFT_W - 4);
      strncpy(prev[idx], s, 39); prev[idx][39] = 0; prevCol[idx] = col;
    }
  };
  for (;;) {
    uint32_t blocked, allowed, items;
    LedState st;
    getAppStats(&blocked, &allowed, &items, &st);

    const char* stTxt = "READY"; uint16_t stCol = C_GREEN;
    switch (st) {
      case LED_OK: stTxt = "ATTIVO"; stCol = C_GREEN; break;
      case LED_OFFLINE: stTxt = "OFFLINE"; stCol = C_CYAN; break;
      case LED_DOWNLOAD: stTxt = "SCARICO LISTA"; stCol = C_YELLOW; break;
      case LED_AP_MODE: stTxt = "SETUP WIFI AP"; stCol = C_YELLOW; break;
      case LED_FAIL: stTxt = "ERRORE"; stCol = C_RED; break;
    }
    bool ap = (st == LED_AP_MODE) || !ST_SSID[0];
    if (ap) { stTxt = "SETUP WIFI AP"; stCol = C_YELLOW; }

    IPAddress sta = WiFi.STA.localIP();
    if (ap) snprintf(line, sizeof(line), "192.168.4.1");
    else if ((uint32_t)sta == 0) snprintf(line, sizeof(line), "Connessione...");
    else snprintf(line, sizeof(line), "%u.%u.%u.%u", sta[0], sta[1], sta[2], sta[3]);
    show(0, 2, line, ((uint32_t)sta == 0 && !ap) ? C_YELLOW : C_WHITE, ((uint32_t)sta == 0 && !ap) ? 1 : 2);
    show(1, 22, stTxt, stCol);

    snprintf(line, sizeof(line), "Bloccati: %lu", (unsigned long)blocked);
    show(2, 34, line, C_RED);
    snprintf(line, sizeof(line), "Permessi: %lu", (unsigned long)allowed);
    show(3, 44, line, C_GREEN);
    snprintf(line, sizeof(line), "Lista: %lu domini", (unsigned long)(items > 2 ? items - 2 : 0));
    show(4, 54, line, C_CYAN);

    char up[16]; fmtUptime(up, sizeof(up), millis() / 1000);
    int rssi = netIsConnected() ? netRSSI() : 0;
    if (rssi) snprintf(line, sizeof(line), "%ddBm up %s", rssi, up);
    else snprintf(line, sizeof(line), "up %s", up);
    show(5, 64, line, C_GREY);
    snprintf(line, sizeof(line), "RAM%luK PS%luK",
             (unsigned long)(ESP.getFreeHeap() / 1024), (unsigned long)(ESP.getFreePsram() / 1024));
    show(6, 72, line, C_GREY);
    vTaskDelay(pdMS_TO_TICKS(1000));
  }
}

void displayStart() {
  xTaskCreatePinnedToCore(displayTask, "display", 4096, NULL, 1, NULL, 1);
}
